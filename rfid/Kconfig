## rfid/Kconfig
```kconfig
config CHAFON_RFID_READER
	tristate "Chafon RFID reader driver"
	depends on OF
	help
          Say Y here to build the chafon rfid reader driver.
          To compile this driver as a module, choose M here:
          the module will be called rfid_reader_m.
```
